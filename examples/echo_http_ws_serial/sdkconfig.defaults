## examples/http/https_server/sdkconfig.defaults
```kconfig
CONFIG_BOOTLOADER_LOG_LEVEL=1
CONFIG_COMPILER_OPTIMIZATION_SIZE=y
CONFIG_ESP_HTTPS_SERVER_ENABLE=y
CONFIG_COMPILER_OPTIMIZATION_ASSERTIONS_DISABLE=y
CONFIG_COMPILER_OPTIMIZATION_ASSERTION_LEVEL=0
```

## examples/http/login_wifi/main/Kconfig.projbuild
```kconfig
menu "Example Configuration"
  config WIFI_AP_SSID
    string "AP SSID"
    default "eelreless net"
    help
      The name of the access point to connect when configuring the WiFi

  choice ESP_WIFI_SAE_MODE
    prompt "WPA3 SAE mode selection"
    default ESP_WPA3_SAE_PWE_BOTH
    help
        Select mode for SAE as Hunt and Peck, H2E or both.
    config ESP_WPA3_SAE_PWE_HUNT_AND_PECK
        bool "HUNT AND PECK"
    config ESP_WPA3_SAE_PWE_HASH_TO_ELEMENT
        bool "H2E"
    config ESP_WPA3_SAE_PWE_BOTH
        bool "BOTH"
  endchoice

  config ESP_WIFI_PW_ID
    string "PASSWORD IDENTIFIER"
    depends on  ESP_WPA3_SAE_PWE_HASH_TO_ELEMENT|| ESP_WPA3_SAE_PWE_BOTH
    default ""
    help
        password identifier for SAE H2E

  config ESP_MAXIMUM_RETRY
    int "Maximum retry"
    default 5
    help
        Set the Maximum retry to avoid station reconnecting to the AP unlimited when the AP is really inexistent.

  choice ESP_WIFI_SCAN_AUTH_MODE_THRESHOLD
    prompt "WiFi Scan auth mode threshold"
    default ESP_WIFI_AUTH_WPA2_PSK
    help
      The weakest authmode to accept in the scan mode.
      This value defaults to ESP_WIFI_AUTH_WPA2_PSK incase password is present and ESP_WIFI_AUTH_OPEN is used.
      Please select ESP_WIFI_AUTH_WEP/ESP_WIFI_AUTH_WPA_PSK incase AP is operating in WEP/WPA mode.

    config ESP_WIFI_AUTH_OPEN
        bool "OPEN"
    config ESP_WIFI_AUTH_WEP
        bool "WEP"
    config ESP_WIFI_AUTH_WPA_PSK
        bool "WPA PSK"
    config ESP_WIFI_AUTH_WPA2_PSK
        bool "WPA2 PSK"
    config ESP_WIFI_AUTH_WPA_WPA2_PSK
        bool "WPA/WPA2 PSK"
    config ESP_WIFI_AUTH_WPA3_PSK
        bool "WPA3 PSK"
    config ESP_WIFI_AUTH_WPA2_WPA3_PSK
        bool "WPA2/WPA3 PSK"
    config ESP_WIFI_AUTH_WAPI_PSK
        bool "WAPI PSK"
  endchoice
  
  config ENABLE_MDNS
    bool "Enable local name resolution"
    default n
    help
      Make your device reachable at the local network using a easy 
      name (instead of a IP).

  config MDNS_HOSTNAME
    string "Local hostname"
    default "eelreless"
    depends on ENABLE_MDNS
    help
      Name that the device will be reachable locally (<name>.local)

  config PIN_BUTTON
    int "Button to hold to erase WiFi parameters"
    default 0
    help
      Holding this button for TIME_HOLD_BUTTON time will make the device
      erase any configuration store of WiFi and reboot the device.

  config TIME_HOLD_BUTTON
    int "Seconds to hold the erase button to take effect"
    default 3

endmenu
```

## examples/ota/websocket/sdkconfig.defaults
```kconfig
CONFIG_WS_TRANSPORT=y
CONFIG_HTTPD_WS_SUPPORT=y
CONFIG_BOOTLOADER_APP_ROLLBACK_ENABLE=y
CONFIG_PARTITION_TABLE_TWO_OTA=y
```

## examples/wifi/simple_wps_retry/main/Kconfig.projbuild
```kconfig
menu "Example Configuration"
    config ESP_MAXIMUM_RETRY
        int "Maximum retry"
        default 5
        help
            Set the Maximum retry to avoid station reconnecting to the AP unlimited when the AP is really inexistent.
endmenu
```
